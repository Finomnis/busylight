## CMakeLists.txt
```
cmake_minimum_required(VERSION 3.20.0)

find_package(Zephyr REQUIRED HINTS $ENV{ZEPHYR_BASE})
project(app LANGUAGES C CXX)

# Verify that this sample is built through sysbuild to ensure MCUboot is
# automatically included and that sample specific MCUboot configurations are
# used when building MCUboot.
test_sysbuild(REQUIRED)

target_compile_options(app PRIVATE
    -Wall -Wextra
    # Checks that are incompatible with Zephyr
    -Wno-variadic-macros
    -Wno-type-limits
)

add_subdirectory(src)
```

## sysbuild.conf
```
# Sysbuild configuration file.

# Enable MCUboot using overwrite only mode for this sample.
SB_CONFIG_BOOTLOADER_MCUBOOT=y
SB_CONFIG_MCUBOOT_MODE_SWAP_USING_OFFSET=y

SB_CONFIG_BOOT_ENCRYPTION=y
SB_CONFIG_BOOT_SIGNATURE_TYPE_ED25519=y
SB_CONFIG_BOOT_SIGNATURE_KEY_FILE="${APP_DIR}/keys/signing-key-ed25519.pem"
SB_CONFIG_BOOT_ENCRYPTION_KEY_FILE="${APP_DIR}/keys/encryption-key-x25519.pem"
```

## prj.conf
```kconfig
CONFIG_LOG=y
CONFIG_LOG_BACKEND_UART=y
CONFIG_REBOOT=y

# CONFIG_LOG_MODE_IMMEDIATE=y

# CONFIG_SHELL=y
# CONFIG_SHELL_LOG_BACKEND=y
# CONFIG_LED_STRIP_SHELL=y

CONFIG_LED_STRIP=y
CONFIG_WS2812_STRIP_SPI=y
CONFIG_WS2812_STRIP_SPI_FORCE_NOCACHE=y

CONFIG_LED_STRIP_LOG_LEVEL_DBG=y
CONFIG_SPI_LOG_LEVEL_DBG=y


CONFIG_DMA=y
CONFIG_SPI_STM32_DMA=y
```

## src/main.c
```c
#include <zephyr/device.h>
#include <zephyr/kernel.h>
#include <zephyr/linker/linker-defs.h>
#include <zephyr/logging/log.h>

#include <zephyr/drivers/led_strip.h>

#include <app_version.h>

LOG_MODULE_REGISTER(app, LOG_LEVEL_DBG);

static const struct device *led_strip = DEVICE_DT_GET(DT_ALIAS(led_strip));

int main(void)
{
    LOG_INF("Busylight Application %s (git: %s)", APP_VERSION_STRING, STRINGIFY(APP_BUILD_VERSION));

    if (!device_is_ready(led_strip)) {
        LOG_ERR("LED strip driver is not ready");
        return 0;
    }

    size_t num_leds = led_strip_length(led_strip);

    LOG_INF("Number of leds: %d", (int)num_leds);

    struct led_rgb color = {
        .r = 100,
        .g = 100,
        .b = 100,
    };

    int success = led_strip_update_rgb(led_strip, &color, 1);

    if (0 != success) {
        LOG_ERR("Failed to set color: %d", success);
    }

    return 0;
}
```
