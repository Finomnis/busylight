## firmware/busylight/west.yml
```yaml
manifest:
  self:
    path: busylight
  remotes:
    - name: zephyrproject-rtos
      url-base: https://github.com/zephyrproject-rtos

  projects:
    - name: zephyr
      remote: zephyrproject-rtos
      revision: v4.3.0
      import:
        # By using name-allowlist we can clone only the modules that are
        # strictly needed by the application.
        name-allowlist:
          - cmsis_6 # required by the ARM port
          - hal_stm32
          - mcuboot
          #- segger
          #- lvgl
          #- zcbor
          #- mcumgr
          #- littlefs
          #- mbedtls
```

## firmware_zephyr/busylight/bsp/boards/finomnis/busylight/board.yml
```yaml
board:
  name: busylight
  full_name: BUSYLIGHT
  vendor: finomnis
  socs:
    - name: stm32u073xx
```

## firmware_zephyr/busylight/west.yml
```yaml
manifest:
  self:
    path: busylight
  remotes:
    - name: zephyrproject-rtos
      url-base: https://github.com/zephyrproject-rtos

  projects:
    - name: zephyr
      remote: zephyrproject-rtos
      revision: v4.4.0-rc2
      import:
        # By using name-allowlist we can clone only the modules that are
        # strictly needed by the application.
        name-allowlist:
          - cmsis_6 # required by the ARM port
          - hal_stm32
          - mcuboot
          - mbedtls
          - zcbor
          #- segger
          #- lvgl
          #- mcumgr
          #- littlefs
```
